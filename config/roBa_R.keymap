#include "roBa_L.keymap"
#include "boards/shields/roBa/roBa_R.overlay"

&trackball {
    compatible = "pixart,pmw3610-alt";
    automouse-layer = <L_MOUSE>;
    scroll-layers = <L_US_SYMBOL L_FUNCTION>;
    // snipe-layer = <3>;

    arrows {
        layers = <L_ARROW>;
        bindings =
            <&kp RIGHT_ARROW>,
            <&kp LEFT_ARROW>,
            <&kp UP_ARROW>,
            <&kp DOWN_ARROW>;

        tick = <10>;
        wait-ms = <5>;
        tap-ms = <5>;
    };
};
